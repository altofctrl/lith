#define LGFX_USE_V1
#include <LovyanGFX.hpp>
#include <Preferences.h>

// --- Type declarations at the very top, before any function that mentions them ---
enum AppState { IDLE, RUNNING, PAUSED };

struct ButtonState {
  uint8_t pin;
  bool lastStable;
  bool longPressed;
  uint32_t changeMs;
  uint32_t pressStart;
  bool shortPress;
  bool longPress;
};

// --- Hardware pins ---
#define PIN_SW1     1
#define PIN_SW2     2
#define PIN_ENC_A   4
#define PIN_ENC_B   5

// --- Display class, verbatim from lith display_init snippet ---
class LGFX : public lgfx::LGFX_Device {
  lgfx::Panel_ST7789 _panel;
  lgfx::Bus_SPI _bus;
  lgfx::Light_PWM _light;
public:
  LGFX() {
    {
      auto cfg = _bus.config();
      cfg.spi_host = SPI2_HOST;
      cfg.spi_mode = 0;
      cfg.freq_write = 50000000;
      cfg.freq_read = 16000000;
      cfg.spi_3wire = false;
      cfg.use_lock = true;
      cfg.dma_channel = SPI_DMA_CH_AUTO;
      cfg.pin_sclk = 12;
      cfg.pin_mosi = 11;
      cfg.pin_miso = -1;
      cfg.pin_dc = 13;
      _bus.config(cfg);
      _panel.setBus(&_bus);
    }
    {
      auto cfg = _panel.config();
      cfg.pin_cs = 10;
      cfg.pin_rst = 9;
      cfg.pin_busy = -1;
      cfg.panel_width = 170;
      cfg.panel_height = 320;
      cfg.offset_x = 35;
      cfg.offset_y = 0;
      cfg.offset_rotation = 2;
      cfg.readable = false;
      cfg.invert = true;
      cfg.rgb_order = false;
      cfg.dlen_16bit = false;
      cfg.bus_shared = false;
      _panel.config(cfg);
    }
    {
      auto cfg = _light.config();
      cfg.pin_bl = 8;
      cfg.invert = false;
      cfg.freq = 44100;
      cfg.pwm_channel = 7;
      _light.config(cfg);
      _panel.setLight(&_light);
    }
    setPanel(&_panel);
  }
};

LGFX tft;
LGFX_Sprite canvas(&tft);

// --- Colours ---
#define BG_COLOUR     0x1086
#define INK_COLOUR    0xEFB5

// --- Encoder: interrupt-driven quadrature ---
volatile int32_t encRaw = 0;
static uint8_t encState = 0;
static const int8_t encTable[16] = {0,1,-1,0,-1,0,0,1,1,0,0,-1,0,-1,1,0};


// --- prototypes generated by the harness, as arduino-cli does
void IRAM_ATTR encISR();
void pollButton(uint8_t idx);
int32_t readEncoderDetent();
void updateCost();
void handleButtonsAndEncoder();
void drawCenteredText(LGFX_Sprite &spr, const char *text, int y, float scale, uint16_t colour);
void render();

void IRAM_ATTR encISR() {
  uint8_t a = digitalRead(PIN_ENC_A);
  uint8_t b = digitalRead(PIN_ENC_B);
  encState = ((encState << 2) | (a << 1) | b) & 0x0F;
  encRaw += encTable[encState];
}

// --- Buttons as globals, polled by index; no custom type in function signature ---
ButtonState buttons[2] = {
  { PIN_SW1, HIGH, false, 0, 0, false, false },
  { PIN_SW2, HIGH, false, 0, 0, false, false }
};

Preferences prefs;
AppState appState = IDLE;
int rateDollars = 150;
uint64_t totalCents = 0;
uint32_t runStartMs = 0;
uint64_t prePauseCents = 0;
int32_t lastDetent = 0;

// --- Layout ---
const int labelY = 30;
const int idleNumberY = 128;
const int costNumberY = 110;

void pollButton(uint8_t idx) {
  ButtonState &b = buttons[idx];
  bool raw = digitalRead(b.pin);
  uint32_t now = millis();

  if (raw != b.lastStable) {
    if (now - b.changeMs > 25) {
      b.lastStable = raw;
      b.changeMs = now;
      if (raw == LOW) {
        b.pressStart = now;
        b.longPressed = false;
      }
    }
  }

  b.shortPress = false;
  b.longPress = false;

  if (b.lastStable == LOW) {
    if (!b.longPressed && (now - b.pressStart > 800)) {
      b.longPress = true;
      b.longPressed = true;
    }
  } else {
    uint32_t held = now - b.pressStart;
    if (!b.longPressed && (held > 0) && (held < 800)) {
      b.shortPress = true;
    }
    b.pressStart = 0;
  }
}

int32_t readEncoderDetent() {
  int32_t raw;
  noInterrupts();
  raw = encRaw;
  interrupts();
  int32_t det = raw / 4;
  int32_t delta = 0;
  if (det != lastDetent) {
    delta = det - lastDetent;
    lastDetent = det;
  }
  return delta;
}

void updateCost() {
  if (appState != RUNNING) return;
  uint32_t now = millis();
  uint32_t elapsed = now - runStartMs;
  totalCents = prePauseCents + (uint64_t)elapsed * rateDollars * 100ULL / 3600000ULL;
}

void handleButtonsAndEncoder() {
  pollButton(0);
  pollButton(1);

  if (buttons[0].shortPress) {
    switch (appState) {
      case IDLE:
        appState = RUNNING;
        runStartMs = millis();
        prePauseCents = 0;
        totalCents = 0;
        Serial.println("meeting started");
        break;
      case RUNNING:
        appState = PAUSED;
        prePauseCents = totalCents;
        Serial.println("paused");
        break;
      case PAUSED:
        appState = RUNNING;
        runStartMs = millis();
        Serial.println("resumed");
        break;
    }
  }

  if (buttons[0].longPress) {
    if (appState != IDLE) {
      appState = IDLE;
      totalCents = 0;
      Serial.println("reset to idle");
    }
  }

  if (buttons[1].shortPress) {
    appState = IDLE;
    totalCents = 0;
    Serial.println("stopped");
  }

  if (appState == IDLE) {
    int32_t delta = readEncoderDetent();
    if (delta != 0) {
      rateDollars += delta;
      if (rateDollars < 10) rateDollars = 10;
      if (rateDollars > 2000) rateDollars = 2000;
      prefs.begin("meeting", false);
      prefs.putInt("rate", rateDollars);
      prefs.end();
      Serial.printf("rate now $%d/hr\n", rateDollars);
    }
  } else {
    readEncoderDetent();
  }
}

void drawCenteredText(LGFX_Sprite &spr, const char *text, int y, float scale, uint16_t colour) {
  spr.setTextSize(scale);
  int w = spr.textWidth(text) * scale;
  int x = (320 - w) / 2;
  spr.setCursor(x, y);
  spr.setTextColor(colour);
  spr.print(text);
}

void render() {
  canvas.fillSprite(BG_COLOUR);
  canvas.setFont(&fonts::Font2);
  canvas.setTextDatum(textdatum_t::top_left);
  canvas.setTextColor(INK_COLOUR);

  if (appState == IDLE) {
    drawCenteredText(canvas, "RATE/HOUR", labelY, 1.0f, INK_COLOUR);
    char rate[16];
    snprintf(rate, sizeof(rate), "$%d", rateDollars);
    drawCenteredText(canvas, rate, idleNumberY, 3.5f, INK_COLOUR);
  } else {
    const char *label = (appState == PAUSED) ? "PAUSED" : "COST";
    drawCenteredText(canvas, label, labelY, 1.0f, INK_COLOUR);
    char cost[24];
    uint64_t dollars = totalCents / 100;
    uint64_t cents = totalCents % 100;
    snprintf(cost, sizeof(cost), "$%llu.%02llu", dollars, cents);
    drawCenteredText(canvas, cost, costNumberY, 2.5f, INK_COLOUR);
  }

  canvas.pushSprite(0, 0);
}

void setup() {
  Serial.begin(115200);

  pinMode(PIN_SW1, INPUT_PULLUP);
  pinMode(PIN_SW2, INPUT_PULLUP);
  pinMode(PIN_ENC_A, INPUT_PULLUP);
  pinMode(PIN_ENC_B, INPUT_PULLUP);
  attachInterrupt(digitalPinToInterrupt(PIN_ENC_A), encISR, CHANGE);
  attachInterrupt(digitalPinToInterrupt(PIN_ENC_B), encISR, CHANGE);

  tft.init();
  tft.setRotation(1);
  tft.setBrightness(180);
  canvas.setColorDepth(16);
  canvas.createSprite(320, 170);

  prefs.begin("meeting", false);
  rateDollars = prefs.getInt("rate", 150);
  if (rateDollars < 10) rateDollars = 10;
  if (rateDollars > 2000) rateDollars = 2000;
  prefs.putInt("rate", rateDollars);
  prefs.end();

  Serial.printf("meeting cost meter ready, rate $%d/hr\n", rateDollars);
}

void loop() {
  static uint32_t nextRender = 0;

  handleButtonsAndEncoder();
  updateCost();

  uint32_t now = millis();
  if (now >= nextRender) {
    nextRender = now + 33;
    render();
  }

  while (Serial.available()) {
    Serial.read();
  }
}
