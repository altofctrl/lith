#define LGFX_USE_V1
#include <LovyanGFX.hpp>
#include <Preferences.h>

class LGFX : public lgfx::LGFX_Device {
  lgfx::Panel_ST7789 _panel; lgfx::Bus_SPI _bus; lgfx::Light_PWM _light;
public:
  LGFX() {
    { auto cfg = _bus.config(); cfg.spi_host = SPI2_HOST; cfg.spi_mode = 0;
      cfg.freq_write = 50000000; cfg.freq_read = 16000000; cfg.spi_3wire = false;
      cfg.use_lock = true; cfg.dma_channel = SPI_DMA_CH_AUTO;
      cfg.pin_sclk = 12; cfg.pin_mosi = 11; cfg.pin_miso = -1; cfg.pin_dc = 13;
      _bus.config(cfg); _panel.setBus(&_bus); }
    { auto cfg = _panel.config(); cfg.pin_cs = 10; cfg.pin_rst = 9; cfg.pin_busy = -1;
      cfg.panel_width = 170; cfg.panel_height = 320; cfg.offset_x = 35; cfg.offset_y = 0;
      cfg.offset_rotation = 2; cfg.readable = false; cfg.invert = true;
      cfg.rgb_order = false; cfg.dlen_16bit = false; cfg.bus_shared = false;
      _panel.config(cfg); }
    { auto cfg = _light.config(); cfg.pin_bl = 8; cfg.invert = false;
      cfg.freq = 44100; cfg.pwm_channel = 7; _light.config(cfg); _panel.setLight(&_light); }
    setPanel(&_panel);
  }
};

LGFX tft;
Preferences prefs;

const uint16_t PIN_SW1 = 1;
const uint16_t PIN_SW2 = 2;
const uint16_t PIN_MOTOR = 6;

enum State { IDLE, RUNNING, PAUSED };
State state = IDLE;

uint32_t elapsedMs = 0;
uint32_t startTimeMs = 0;
uint32_t pausedAtMs = 0;

uint32_t lastRenderMs = 0;
const uint32_t RENDER_INTERVAL = 25;

uint32_t sw1PressTimeMs = 0;
bool sw1WasPressed = false;
const uint32_t LONG_PRESS_THRESHOLD = 800;

uint32_t motorPulseUntil = 0;


// --- prototypes generated by the harness, as arduino-cli does
void motorPulse(uint8_t duty, uint32_t durationMs);
void motorService();
void pollButton();
void handleSW1ShortPress();
void handleSW1LongPress();
void updateElapsed();
void render();

void motorPulse(uint8_t duty, uint32_t durationMs) {
  ledcWrite(PIN_MOTOR, duty);
  motorPulseUntil = millis() + durationMs;
}

void motorService() {
  if (millis() >= motorPulseUntil) {
    ledcWrite(PIN_MOTOR, 0);
  }
}

void pollButton() {
  bool sw1Raw = digitalRead(PIN_SW1) == LOW;
  
  if (sw1Raw && !sw1WasPressed) {
    sw1PressTimeMs = millis();
    sw1WasPressed = true;
    motorPulse(100, 30);
  } else if (!sw1Raw && sw1WasPressed) {
    uint32_t heldMs = millis() - sw1PressTimeMs;
    sw1WasPressed = false;
    
    if (heldMs >= LONG_PRESS_THRESHOLD) {
      handleSW1LongPress();
    } else {
      handleSW1ShortPress();
    }
  }
  
  bool sw2Raw = digitalRead(PIN_SW2) == LOW;
  static bool sw2WasPressed = false;
  if (sw2Raw && !sw2WasPressed) {
    sw2WasPressed = true;
    motorPulse(100, 30);
  } else if (!sw2Raw && sw2WasPressed) {
    sw2WasPressed = false;
  }
}

void handleSW1ShortPress() {
  if (state == IDLE) {
    state = RUNNING;
    startTimeMs = millis();
    pausedAtMs = 0;
    motorPulse(150, 80);
    Serial.println("[METER] Started");
  } else if (state == RUNNING) {
    state = PAUSED;
    pausedAtMs = elapsedMs;
    motorPulse(100, 100);
    Serial.println("[METER] Paused");
  } else if (state == PAUSED) {
    state = RUNNING;
    startTimeMs = millis();
    motorPulse(150, 80);
    Serial.println("[METER] Resumed");
  }
}

void handleSW1LongPress() {
  state = IDLE;
  elapsedMs = 0;
  startTimeMs = 0;
  pausedAtMs = 0;
  motorPulse(200, 50);
  Serial.println("[METER] Reset");
}

void updateElapsed() {
  if (state == RUNNING) {
    elapsedMs = pausedAtMs + (millis() - startTimeMs);
  }
}

void render() {
  uint32_t now = millis();
  if (now < lastRenderMs + RENDER_INTERVAL) {
    return;
  }
  lastRenderMs = now;
  
  static LGFX_Sprite sprite(&tft);
  if (!sprite.createSprite(320, 170)) {
    return;
  }
  
  sprite.fillScreen(TFT_BLACK);
  
  uint32_t seconds = elapsedMs / 1000;
  uint32_t minutes = seconds / 60;
  uint32_t hours = minutes / 60;
  uint32_t secsRem = seconds % 60;
  uint32_t minsRem = minutes % 60;
  
  float progress = 0.0;
  if (elapsedMs > 0) {
    progress = fmin(1.0, (float)elapsedMs / 3600000.0);
  }
  
  uint16_t barHeightPx = (uint16_t)(progress * 170.0);
  uint16_t ink = TFT_WHITE;
  uint16_t accentColor = TFT_BLACK;
  
  if (progress < 0.25) {
    accentColor = sprite.color565(100, 180, 50);
  } else if (progress < 0.5) {
    accentColor = sprite.color565(200, 160, 50);
  } else if (progress < 0.75) {
    accentColor = sprite.color565(220, 120, 50);
  } else {
    accentColor = sprite.color565(200, 60, 60);
  }
  
  if (barHeightPx > 0) {
    sprite.fillRect(0, 170 - barHeightPx, 320, barHeightPx, accentColor);
  }
  
  char timeStr[32];
  snprintf(timeStr, sizeof(timeStr), "%02lu:%02lu:%02lu", hours, minsRem, secsRem);
  
  sprite.setTextSize(2);
  sprite.setTextColor(ink);
  sprite.setFont(nullptr);
  int16_t x16 = 160 - sprite.textWidth(timeStr) / 2;
  sprite.drawString(timeStr, x16, 60);
  
  const char* stateLabel = "IDLE";
  if (state == RUNNING) stateLabel = "RUNNING";
  else if (state == PAUSED) stateLabel = "PAUSED";
  
  sprite.setTextSize(1);
  sprite.setTextColor(ink);
  sprite.setFont(nullptr);
  int16_t labelX = 160 - sprite.textWidth(stateLabel) / 2;
  sprite.drawString(stateLabel, labelX, 110);
  
  sprite.pushSprite(0, 0);
  sprite.deleteSprite();
}

void setup() {
  Serial.begin(115200);
  delay(500);
  Serial.println("[LITH] Meeting cost meter booting");
  
  tft.init();
  tft.setRotation(1);
  tft.setBrightness(180);
  
  pinMode(PIN_SW1, INPUT_PULLUP);
  pinMode(PIN_SW2, INPUT_PULLUP);
  
  ledcAttach(PIN_MOTOR, 20000, 8);
  ledcWrite(PIN_MOTOR, 0);
  
  Serial.println("[LITH] Setup complete. SW1 short: start/pause/resume. SW1 long: reset.");
}

void loop() {
  pollButton();
  updateElapsed();
  motorService();
  render();
}
