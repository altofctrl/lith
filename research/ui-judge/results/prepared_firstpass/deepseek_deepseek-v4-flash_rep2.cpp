#define LGFX_USE_V1
#include <LovyanGFX.hpp>
#include <Preferences.h>

// --- Hardware pins (lith v1) ---
#define PIN_TFT_SCLK 12
#define PIN_TFT_MOSI 11
#define PIN_TFT_DC   13
#define PIN_TFT_CS   10
#define PIN_TFT_RST  9
#define PIN_TFT_BLK  8
#define PIN_SW1      1
#define PIN_SW2      2
#define PIN_ENC_A    4
#define PIN_ENC_B    5
#define PIN_MOTOR    6

// --- Display init (verbatim from hardware spec) ---
class LGFX : public lgfx::LGFX_Device {
  lgfx::Panel_ST7789 _panel; lgfx::Bus_SPI _bus; lgfx::Light_PWM _light;
public:
  LGFX() {
    { auto cfg = _bus.config(); cfg.spi_host = SPI2_HOST; cfg.spi_mode = 0;
      cfg.freq_write = 50000000; cfg.freq_read = 16000000; cfg.spi_3wire = false;
      cfg.use_lock = true; cfg.dma_channel = SPI_DMA_CH_AUTO;
      cfg.pin_sclk = 12; cfg.pin_mosi = 11; cfg.pin_miso = -1; cfg.pin_dc = 13;
      _bus.config(cfg); _panel.setBus(&_bus); }
    { auto cfg = _panel.config(); cfg.pin_cs = 10; cfg.pin_rst = 9; cfg.pin_busy = -1;
      cfg.panel_width = 170; cfg.panel_height = 320; cfg.offset_x = 35; cfg.offset_y = 0;
      cfg.offset_rotation = 2; cfg.readable = false; cfg.invert = true;
      cfg.rgb_order = false; cfg.dlen_16bit = false; cfg.bus_shared = false;
      _panel.config(cfg); }
    { auto cfg = _light.config(); cfg.pin_bl = 8; cfg.invert = false;
      cfg.freq = 44100; cfg.pwm_channel = 7; _light.config(cfg); _panel.setLight(&_light); }
    setPanel(&_panel);
  }
};

LGFX tft;
LGFX_Sprite sprite(&tft);
Preferences prefs;

// --- Colors ---
const uint16_t BG_COLOR = tft.color565(9, 10, 12);
const uint16_t INK_COLOR = tft.color565(238, 240, 245);

// --- State ---
enum AppState { ST_IDLE, ST_RUNNING, ST_PAUSED };
AppState appState = ST_IDLE;

// --- Meeting cost ---
int rate = 80;                        // dollars per hour, adjustable in idle
unsigned long accumulatedMs = 0;      // total paused time
unsigned long stateStartMs = 0;       // when current run/pause phase started
float currentCost = 0;                // dollars, computed each frame

// --- Encoder ---
volatile int encRaw = 0;
int encDetentLast = 0;
const int ENC_LOOKUP[4] = {0, 1, -1, 0};

void IRAM_ATTR encISR() {
  static uint8_t last = 0;
  uint8_t ab = (digitalRead(PIN_ENC_A) << 1) | digitalRead(PIN_ENC_B);
  uint8_t idx = (last << 2) | ab;
  encRaw += ENC_LOOKUP[idx & 0x03];
  if (idx & 0x04) last = ab;
}

// --- Button handling (non-blocking) ---
struct Button {
  uint8_t pin;
  bool lastState;
  bool pressed;
  bool longPressed;
  unsigned long downSince;
  Button(uint8_t p) : pin(p), lastState(true), pressed(false), longPressed(false), downSince(0) {}
  void poll() {
    bool state = digitalRead(pin); // active low, true = released
    bool now = !state; // pressed = low = true
    if (now && !lastState) {
      pressed = true;
      downSince = millis();
      longPressed = false;
    } else if (!now && lastState) {
      if (millis() - downSince >= 800) longPressed = true;
      pressed = false;
    }
    lastState = now;
  }
  void clear() { pressed = false; longPressed = false; }
};

Button sw1(PIN_SW1);
Button sw2(PIN_SW2);

// --- Cost color: green -> red by cost (hue 120 -> 0) ---

// --- prototypes generated by the harness, as arduino-cli does
uint16_t costColor(float cost);
void initMotor();
void drainSerial();
void render();
void startMeeting();
void pauseMeeting();
void endMeeting();
void handleEncoder();
void handleButtons();
void updateCost();

uint16_t costColor(float cost) {
  const float maxCost = 300.0;
  float t = constrain(cost / maxCost, 0.0, 1.0);
  float hue = (1.0 - t) * 120.0; // 0=red, 120=green
  // simple HSV to RGB
  float h = hue / 60.0;
  int i = (int)h;
  float f = h - i;
  uint8_t p = 0, q = 255 * (1 - f), r = 255 * f;
  uint8_t rr, gg, bb;
  switch (i % 6) {
    case 0: rr = 255; gg = r; bb = p; break;
    case 1: rr = q; gg = 255; bb = p; break;
    case 2: rr = p; gg = 255; bb = r; break;
    case 3: rr = p; gg = q; bb = 255; break;
    case 4: rr = r; gg = p; bb = 255; break;
    default: rr = 255; gg = p; bb = q; break;
  }
  return tft.color565(rr, gg, bb);
}

// --- Motor off (silent) ---
void initMotor() {
  pinMode(PIN_MOTOR, OUTPUT);
  digitalWrite(PIN_MOTOR, LOW);
}

// --- Serial input drain (per heuristics) ---
void drainSerial() {
  while (Serial.available()) {
    // not used, but keep loop responsive
    Serial.read();
  }
}

// --- Render ---
unsigned long tNext = 0;
const unsigned long FRAME_MS = 30; // ~33 fps

void render() {
  if (millis() < tNext) return;
  tNext = millis() + FRAME_MS;

  if (!sprite.created()) {
    sprite.setColorDepth(16);
    // try SRAM first, fall back to PSRAM as per heuristics
    if (!sprite.createSprite(320, 170)) {
      // SPI RAM not available; nothing we can do, skip frame
      return;
    }
  }

  sprite.fillSprite(BG_COLOR);

  if (appState == ST_IDLE) {
    // big number: rate
    sprite.setTextColor(INK_COLOR);
    sprite.setFont(&fonts::FreeSansBold36pt7b);
    sprite.setTextDatum(middle_center);
    char buf[16];
    snprintf(buf, sizeof(buf), "$%d", rate);
    sprite.drawString(buf, 160, 84);

    // small label
    sprite.setFont(&fonts::FreeSansBold12pt7b);
    sprite.drawString("RATE / HR", 160, 28);

  } else {
    // meeting cost light: glowing circle in center
    float cost = currentCost;
    uint16_t col = costColor(cost);
    int cx = 160, cy = 85;
    int radius = 70;

    if (appState == ST_RUNNING) {
      sprite.fillCircle(cx, cy, radius, col);
      // subtle dark center to feel like a light source
      sprite.fillCircle(cx, cy, radius * 0.65, tft.color565(20, 24, 28));
      sprite.fillCircle(cx, cy, radius * 0.65, col); // actually we want a glow, but keep simple
    } else { // ST_PAUSED
      sprite.drawCircle(cx, cy, radius, col);
      sprite.drawCircle(cx, cy, radius - 8, col);
    }
  }

  sprite.pushSprite(0, 0);
}

// --- Meeting logic ---
void startMeeting() {
  appState = ST_RUNNING;
  stateStartMs = millis();
  accumulatedMs = 0;
  currentCost = 0;
  Serial.println("[meeting] started");
}

void pauseMeeting() {
  if (appState == ST_RUNNING) {
    accumulatedMs += millis() - stateStartMs;
    appState = ST_PAUSED;
    Serial.println("[meeting] paused");
  } else if (appState == ST_PAUSED) {
    stateStartMs = millis();
    appState = ST_RUNNING;
    Serial.println("[meeting] resumed");
  }
}

void endMeeting() {
  if (appState != ST_IDLE) {
    Serial.printf("[meeting] ended, total cost $%.2f\n", currentCost);
  }
  appState = ST_IDLE;
  stateStartMs = 0;
  accumulatedMs = 0;
  currentCost = 0;
}

// --- Encoder handling ---
void handleEncoder() {
  int detent;
  noInterrupts();
  detent = encRaw / 4;
  interrupts();
  int delta = detent - encDetentLast;
  if (delta && appState == ST_IDLE) {
    encDetentLast = detent;
    rate = constrain(rate + delta * 5, 10, 500);
    prefs.putInt("rate", rate);
    Serial.printf("[rate] %d\n", rate);
  } else {
    encDetentLast = detent;
  }
}

// --- Button handling ---
void handleButtons() {
  sw1.poll();
  sw2.poll();

  if (sw1.pressed) {
    sw1.clear();
    switch (appState) {
      case ST_IDLE: startMeeting(); break;
      case ST_RUNNING: pauseMeeting(); break;
      case ST_PAUSED: pauseMeeting(); break;
    }
  }
  if (sw1.longPressed) {
    sw1.clear();
    endMeeting();
  }
  if (sw2.pressed) {
    sw2.clear();
    // intentionally unused for now
  }
}

// --- Update cost every frame ---
void updateCost() {
  if (appState == ST_RUNNING) {
    unsigned long totalMs = accumulatedMs + (millis() - stateStartMs);
    float hours = totalMs / 3600000.0;
    currentCost = rate * hours;
  } else if (appState == ST_PAUSED) {
    float hours = accumulatedMs / 3600000.0;
    currentCost = rate * hours;
  }
}

// --- Setup ---
void setup() {
  Serial.begin(115200);

  // buttons and encoder as input pullups
  pinMode(PIN_SW1, INPUT_PULLUP);
  pinMode(PIN_SW2, INPUT_PULLUP);
  pinMode(PIN_ENC_A, INPUT_PULLUP);
  pinMode(PIN_ENC_B, INPUT_PULLUP);
  attachInterrupt(digitalPinToInterrupt(PIN_ENC_A), encISR, CHANGE);
  attachInterrupt(digitalPinToInterrupt(PIN_ENC_B), encISR, CHANGE);

  initMotor();

  // load saved rate
  prefs.begin("lith", false);
  rate = prefs.getInt("rate", 80);

  // display init
  tft.init();
  tft.setRotation(1);
  tft.setBrightness(180);

  sprite.setColorDepth(16);
  sprite.createSprite(320, 170);

  Serial.println("[lith] meeting-glow ready");
}

// --- Loop ---
void loop() {
  drainSerial();
  handleEncoder();
  handleButtons();
  updateCost();
  render();
}
