#define LGFX_USE_V1
#include <LovyanGFX.hpp>
#include <Preferences.h>
#include <qrcode_ricmoo.h>

// display init – use verbatim snippet
class LGFX : public lgfx::LGFX_Device {
  lgfx::Panel_ST7789 _panel; lgfx::Bus_SPI _bus; lgfx::Light_PWM _light;
public:
  LGFX() {
    { auto cfg = _bus.config(); cfg.spi_host = SPI2_HOST; cfg.spi_mode = 0;
      cfg.freq_write = 50000000; cfg.freq_read = 16000000; cfg.spi_3wire = false;
      cfg.use_lock = true; cfg.dma_channel = SPI_DMA_CH_AUTO;
      cfg.pin_sclk = 12; cfg.pin_mosi = 11; cfg.pin_miso = -1; cfg.pin_dc = 13;
      _bus.config(cfg); _panel.setBus(&_bus); }
    { auto cfg = _panel.config(); cfg.pin_cs = 10; cfg.pin_rst = 9; cfg.pin_busy = -1;
      cfg.panel_width = 170; cfg.panel_height = 320; cfg.offset_x = 35; cfg.offset_y = 0;
      cfg.offset_rotation = 2; cfg.readable = false; cfg.invert = true;
      cfg.rgb_order = false; cfg.dlen_16bit = false; cfg.bus_shared = false;
      _panel.config(cfg); }
    { auto cfg = _light.config(); cfg.pin_bl = 8; cfg.invert = false;
      cfg.freq = 44100; cfg.pwm_channel = 7; _light.config(cfg); _panel.setLight(&_light); }
    setPanel(&_panel);
  }
};

LGFX tft;
lgfx::LGFX_Sprite canvas(&tft);

// pin definitions (from hardware JSON)
#define PIN_TFT_SCLK 12
#define PIN_TFT_MOSI 11
#define PIN_TFT_DC   13
#define PIN_TFT_CS   10
#define PIN_TFT_RST  9
#define PIN_TFT_BLK  8
#define PIN_SW1      1
#define PIN_SW2      2
#define PIN_ENC_A    4
#define PIN_ENC_B    5
#define PIN_MOTOR    6 // not used (silent mode)

// button handling
struct Button {
  const uint8_t pin;
  bool lastStable;          // last stable (debounced) state
  unsigned long lastChange; // millis of last state change
  bool longPressed;
};

Button btn1 = {PIN_SW1, HIGH, 0, false}; // active low
Button btn2 = {PIN_SW2, HIGH, 0, false};
const unsigned long DEBOUNCE_MS = 25;
const unsigned long LONG_PRESS_MS = 800;

// encoder handling (interrupt‑driven)
volatile int16_t encoderDelta = 0; // accumulated detents
volatile uint8_t encoderPrev = 0;

inline int8_t encLookup(uint8_t combined) {
  // 4‑bit combined: prev<<2 | cur
  // table from typical quadrature decoding
  static const int8_t table[16] = {0, -1, 1, 0,
                                   1, 0, 0, -1,
                                  -1, 0, 0, 1,
                                   0, 1, -1, 0};
  return table[combined & 0x0F];
}

void IRAM_ATTR encoderISR() {
  uint8_t a = digitalRead(PIN_ENC_A);
  uint8_t b = digitalRead(PIN_ENC_B);
  uint8_t cur = (a << 1) | b;
  uint8_t combined = (encoderPrev << 2) | cur;
  encoderDelta += encLookup(combined);
  encoderPrev = cur;
}

// application state
enum Mode { MODE_TIMER, MODE_RATE };
Mode currentMode = MODE_TIMER;
bool running = false;
unsigned long startMs = 0;      // when current run started
unsigned long elapsedMs = 0;    // accumulated while running
float hourlyRate = 100.0f;      // default $/hour
Preferences prefs;

// timing helpers
unsigned long nextRender = 0;
const unsigned long RENDER_INTERVAL = 30; // ~33 fps

void setup() {
  Serial.begin(115200);
  // pins
  pinMode(PIN_SW1, INPUT_PULLUP);
  pinMode(PIN_SW2, INPUT_PULLUP);
  pinMode(PIN_ENC_A, INPUT_PULLUP);
  pinMode(PIN_ENC_B, INPUT_PULLUP);
  // encoder interrupt
  attachInterrupt(digitalPinToInterrupt(PIN_ENC_A), encoderISR, CHANGE);
  attachInterrupt(digitalPinToInterrupt(PIN_ENC_B), encoderISR, CHANGE);

  // display
  tft.init();
  tft.setRotation(1);
  tft.setBrightness(180);
  canvas.createSprite(320, 170);

  // preferences – store rate
  prefs.begin("costmeter", false);
  hourlyRate = prefs.getFloat("rate", 100.0f);

  Serial.println("meeting cost meter ready");
}

// button polling (non‑blocking)

// --- prototypes generated by the harness, as arduino-cli does
void pollButton(Button &btn);
void handleSW1Short();
void handleSW1Long();
void handleSW2Short();
void handleSW2Long();
void processEncoder();
void render();

void pollButton(Button &btn) {
  bool raw = digitalRead(btn.pin); // HIGH = not pressed
  unsigned long now = millis();
  if (raw != btn.lastStable) {
    // possible bounce – wait debounce period
    if (now - btn.lastChange >= DEBOUNCE_MS) {
      btn.lastStable = raw;
      btn.lastChange = now;
      if (!raw) { // pressed
        btn.longPressed = false; // reset flag
      } else { // released
        if (!btn.longPressed) {
          // short press event
          if (btn.pin == PIN_SW1) handleSW1Short();
          else if (btn.pin == PIN_SW2) handleSW2Short();
        }
        // reset long‑press flag for next cycle
        btn.longPressed = false;
      }
    }
  } else {
    // stable state – check for long press while held
    if (!raw && !btn.longPressed && (now - btn.lastChange >= LONG_PRESS_MS)) {
      btn.longPressed = true;
      if (btn.pin == PIN_SW1) handleSW1Long();
      else if (btn.pin == PIN_SW2) handleSW2Long();
    }
  }
}

void handleSW1Short() {
  if (currentMode == MODE_TIMER) {
    if (running) {
      // pause
      elapsedMs = millis() - startMs;
      running = false;
      Serial.println("paused");
    } else {
      // start / resume
      startMs = millis() - elapsedMs;
      running = true;
      Serial.println("started");
    }
  }
}

void handleSW1Long() {
  // reset timer and cost
  running = false;
  elapsedMs = 0;
  Serial.println("reset");
}

void handleSW2Short() {
  // toggle between timer view and rate‑edit view
  if (currentMode == MODE_TIMER) {
    currentMode = MODE_RATE;
    // stop timer while editing
    if (running) {
      elapsedMs = millis() - startMs;
      running = false;
    }
    Serial.println("edit rate");
  } else {
    currentMode = MODE_TIMER;
    Serial.println("view timer");
  }
}

void handleSW2Long() {
  // not used – placeholder for future features
}

void processEncoder() {
  int16_t delta = 0;
  noInterrupts();
  delta = encoderDelta;
  encoderDelta = 0;
  interrupts();
  if (delta == 0) return;

  if (currentMode == MODE_RATE) {
    // adjust hourly rate by 1 per detent, clamp >=0
    hourlyRate += delta * 1.0f;
    if (hourlyRate < 0) hourlyRate = 0;
    prefs.putFloat("rate", hourlyRate);
    Serial.printf("rate set to %.2f\n", hourlyRate);
  }
  // in timer mode we ignore encoder (could be used for future shortcuts)
}

void render() {
  // clear canvas
  canvas.fillScreen(TFT_BLACK);

  // choose colour for back‑light based on running state
  uint8_t brightness = running ? 255 : 180;
  tft.setBrightness(brightness);

  // compute cost
  float cost = hourlyRate * (elapsedMs / 3600000.0f);

  // draw focal element
  canvas.setTextColor(TFT_WHITE, TFT_BLACK);
  canvas.setTextDatum(middle_center);

  char buf[32];
  if (currentMode == MODE_TIMER) {
    // big cost number
    snprintf(buf, sizeof(buf), "$%0.2f", cost);
    canvas.setTextSize(3);
    canvas.drawString(buf, 160, 85);
    // small label
    canvas.setTextSize(1);
    canvas.setTextDatum(bottom_center);
    canvas.drawString("COST", 160, 30);
  } else {
    // rate edit view
    snprintf(buf, sizeof(buf), "$%0.0f/h", hourlyRate);
    canvas.setTextSize(3);
    canvas.drawString(buf, 160, 85);
    canvas.setTextSize(1);
    canvas.setTextDatum(bottom_center);
    canvas.drawString("RATE", 160, 30);
  }

  // push to display
  canvas.pushSprite(0, 0);
}

void loop() {
  // poll inputs
  pollButton(btn1);
  pollButton(btn2);
  processEncoder();

  // update elapsed time if running
  if (running) {
    elapsedMs = millis() - startMs;
  }

  // throttled render
  unsigned long now = millis();
  if (now >= nextRender) {
    render();
    nextRender = now + RENDER_INTERVAL;
  }
}
