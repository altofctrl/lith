#include <Arduino.h>
#include "LGFX.hpp"

// --- display setup (exactly as hardware truth) ---
LGFX tft;
static LGFX_Sprite sprite(&tft);
static bool sprite_ok = false;

// --- pins ---
constexpr int PIN_SW1 = 1;
constexpr int PIN_SW2 = 2;
constexpr int PIN_ENC_A = 4;
constexpr int PIN_ENC_B = 5;

// --- encoder interrupts ---
volatile int32_t enc_raw = 0;
static int32_t last_enc_val = 0;

void IRAM_ATTR enc_isr() {
  static uint8_t prev = 0;
  uint8_t a = digitalRead(PIN_ENC_A);
  uint8_t b = digitalRead(PIN_ENC_B);
  uint8_t state = (a << 1) | b;
  static const int8_t table[16] = {0,-1,1,0,1,0,0,-1,-1,0,0,1,0,1,-1,0};
  // compute quadrature step
  int8_t step = table[(prev << 2) | state];
  if (step != 0) enc_raw += step;
  prev = state;
}

void setup_encoder() {
  pinMode(PIN_ENC_A, INPUT_PULLUP);
  pinMode(PIN_ENC_B, INPUT_PULLUP);
  attachInterrupt(digitalPinToInterrupt(PIN_ENC_A), enc_isr, CHANGE);
  attachInterrupt(digitalPinToInterrupt(PIN_ENC_B), enc_isr, CHANGE);
}

// --- button debounce ---
struct Button {
  uint8_t pin;
  bool last_stable = true;
  bool current = true;
  uint32_t stable_since = 0;
  uint32_t debounce = 25;
  uint32_t press_start = 0;
  bool pressed = false;
  bool long_triggered = false;

  void init(uint8_t p) {
    pin = p;
    pinMode(pin, INPUT_PULLUP);
    current = digitalRead(pin);
    last_stable = current;
  }

  void update(uint32_t now) {
    bool raw = digitalRead(pin);
    if (raw != current) {
      current = raw;
      stable_since = now;
    } else if (now - stable_since >= debounce) {
      if (raw != last_stable) {
        last_stable = raw;
        if (!raw) {
          // falling edge: press started
          press_start = now;
          pressed = false;
          long_triggered = false;
        } else {
          // rising edge: release
          if (!long_triggered && (now - press_start < 800)) {
            pressed = true; // short press
          }
          press_start = 0;
        }
      } else if (!raw && press_start > 0 && (now - press_start >= 800)) {
        // long press detected
        long_triggered = true;
      }
    }
  }

  bool short_press() {
    bool tmp = pressed;
    pressed = false;
    return tmp;
  }

  bool long_hold() {
    // returns true once when long press threshold crossed
    if (long_triggered && press_start > 0) {
      long_triggered = false; // reset after consumption
      return true;
    }
    return false;
  }
};

Button sw1;

// --- state machine ---
enum class State : uint8_t {
  IDLE,      // editing rate, not timing
  RUNNING,   // meeting active, cost accumulating
  PAUSED     // timing paused, cost frozen
};
State state = State::IDLE;
float rate_per_hour = 150.0;
float cost = 0.0;
uint32_t timer_start = 0;
uint32_t elapsed_saved = 0; // seconds accumulated before current start

// --- display helpers ---
static uint32_t last_render = 0;
constexpr int render_interval = 33; // ~30 fps


// --- prototypes generated by the harness, as arduino-cli does
void draw_idle();
void draw_running(float current_cost);
void draw_paused(float frozen_cost);
void render(uint32_t now);
void update_cost();

void draw_idle() {
  sprite.fillScreen(0x0841); // deep near-black
  sprite.setTextColor(0xEEF0F5); // off-white ink
  sprite.setTextDatum(TC_DATUM);
  // rate number, large
  sprite.setFont(&fonts::Font7); // large 7-segment style font? Actually we need a huge font. Font8? We'll use setTextSize on default or custom.
  // LGFX's built-in huge font: &fonts::DejaVu40? Not available. We'll use setTextSize on the default font, which is proportional.
  // Simpler: use the AdafruitGFX default font scaled up. That's acceptable.
  sprite.setTextSize(3);
  char buf[32];
  snprintf(buf, sizeof(buf), "$%.0f/h", rate_per_hour);
  int16_t tw = sprite.textWidth(buf, &fonts::Font0); // Font0 is default
  sprite.setCursor(160, 85);
  sprite.print(buf);
  // label below
  sprite.setTextSize(1);
  sprite.setFont(&fonts::Font0);
  sprite.setTextDatum(TC_DATUM);
  sprite.setCursor(160, 110);
  sprite.print("RATE");
}

void draw_running(float current_cost) {
  sprite.fillScreen(0x0841);
  sprite.setTextColor(0xEEF0F5);
  // display cost with two decimals
  sprite.setTextSize(3);
  sprite.setTextDatum(TC_DATUM);
  char buf[32];
  snprintf(buf, sizeof(buf), "$%.2f", current_cost);
  int16_t tw = sprite.textWidth(buf);
  sprite.setCursor(160, 85);
  sprite.print(buf);
  // label "COST" below
  sprite.setTextSize(1);
  sprite.setCursor(160, 110);
  sprite.print("COST");

  // subtle breathing indicator when running (small circle)
  if (state == State::RUNNING) {
    uint32_t elapsed = (millis() - timer_start) / 1000;
    float breath = sin(elapsed * 2.0f) * 0.5f + 0.5f; // 0-1 sinusoid
    int r = 4 + (int)(breath * 6); // radius 4-10
    sprite.fillCircle(210, 20, r, 0xEEF0F5); // small dot in corner
  }
}

void draw_paused(float frozen_cost) {
  // same as running but without glowing indicator
  sprite.fillScreen(0x0841);
  sprite.setTextColor(0xEEF0F5);
  sprite.setTextSize(3);
  sprite.setTextDatum(TC_DATUM);
  char buf[32];
  snprintf(buf, sizeof(buf), "$%.2f", frozen_cost);
  sprite.setCursor(160, 85);
  sprite.print(buf);
  sprite.setTextSize(1);
  sprite.setCursor(160, 110);
  sprite.print("COST");
}

void render(uint32_t now) {
  if (!sprite_ok) return;
  if (now - last_render < render_interval) return;
  last_render = now;

  switch (state) {
    case State::IDLE:
      draw_idle();
      break;
    case State::RUNNING: {
      uint32_t elapsed_now = (now - timer_start) / 1000;
      float total_seconds = elapsed_saved + elapsed_now;
      float current = (rate_per_hour / 3600.0f) * total_seconds;
      draw_running(current);
      break;
    }
    case State::PAUSED: {
      // cost frozen
      draw_paused(cost);
      break;
    }
  }

  sprite.pushSprite(0,0);
}

void update_cost() {
  uint32_t now = millis();
  if (state == State::RUNNING) {
    uint32_t elapsed_now = (now - timer_start) / 1000;
    float total_seconds = elapsed_saved + elapsed_now;
    cost = (rate_per_hour / 3600.0f) * total_seconds;
  }
}

void setup() {
  Serial.begin(115200);
  Serial.println("\n=== Meeting cost meter ===");

  // display
  tft.init();
  tft.setRotation(1);
  tft.setBrightness(180);
  // try sprite allocation in PSRAM, then SRAM, then fail
  if (!sprite.createSprite(320, 170)) {
    Serial.println("Failed to allocate sprite");
    sprite_ok = false;
  } else {
    sprite_ok = true;
    sprite.setFont(&fonts::Font0);
  }

  // buttons
  sw1.init(PIN_SW1);

  // encoder
  setup_encoder();

  // state
  state = State::IDLE;
  elapsed_saved = 0;
}

void loop() {
  uint32_t now = millis();

  // process encoder
  int32_t current_enc;
  noInterrupts();
  current_enc = enc_raw;
  interrupts();
  int32_t delta = current_enc - last_enc_val;
  last_enc_val = current_enc;
  if (delta != 0) {
    int32_t detents = delta / 4; // 4 steps per detent
    for (int32_t i = 0; i < abs(detents); i++) {
      if (detents > 0) rate_per_hour += 5;
      else rate_per_hour -= 5;
      if (rate_per_hour < 0) rate_per_hour = 0;
    }
    if (state != State::IDLE) {
      // if running or paused, adjust rate? We'll only edit in IDLE
      // but we'll allow adjusting while idle only. If not idle, ignore.
      // But state is IDLE, so it's fine.
    }
    Serial.printf("Rate: $%.0f/h\n", rate_per_hour);
  }

  // button processing
  sw1.update(now);

  if (sw1.short_press()) {
    Serial.println("SW1 short");
    switch (state) {
      case State::IDLE:
        // start
        state = State::RUNNING;
        timer_start = now;
        elapsed_saved = 0;
        Serial.println("Started meeting");
        break;
      case State::RUNNING:
        // pause
        elapsed_saved += (now - timer_start) / 1000;
        state = State::PAUSED;
        cost = (rate_per_hour / 3600.0f) * elapsed_saved;
        Serial.println("Paused");
        break;
      case State::PAUSED:
        // resume
        state = State::RUNNING;
        timer_start = now;
        Serial.println("Resumed");
        break;
    }
  }

  if (sw1.long_hold()) {
    Serial.println("SW1 long - reset");
    // reset to idle
    state = State::IDLE;
    cost = 0;
    elapsed_saved = 0;
    timer_start = 0;
    Serial.println("Reset");
  }

  // update cost for display
  update_cost();

  // render
  render(now);
}
